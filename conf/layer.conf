## conf/layer.conf
```bitbake
# We have a conf and classes directory, append to BBPATH
BBPATH .= ":${LAYERDIR}"

# We have a recipes directory, add to BBFILES
BBFILES += "${LAYERDIR}/recipes*/*/*.bb ${LAYERDIR}/recipes*/*/*.bbappend"

BBFILE_COLLECTIONS += "meta-licheepinano"
BBFILE_PATTERN_meta-licheepinano := "^${LAYERDIR}/"
BBFILE_PRIORITY_meta-licheepinano = "10"
LAYERSERIES_COMPAT_meta-licheepinano = "dunfell"
```

## conf/machine/include/suniv.inc
```bitbake
require conf/machine/include/tune-arm926ejs.inc
include conf/machine/include/soc-family.inc

SOC_FAMILY = "suniv"

KERNEL_IMAGETYPE ?= "uImage"

IMAGE_CLASSES += "spi-nor-jffs2"
IMAGE_FSTYPES += "ext4 tar.gz sunxi-spinor"
```

## conf/machine/licheepinano-sdcard.conf
```bitbake
#@TYPE: Machine
#@NAME: lichee-pi-nano
#@DESCRIPTION: Machine configuration for the lichee-pi-nano, base on Allwinner F1C100s CPU

include conf/machine/include/suniv.inc

SOC_FAMILY = "suniv"

PREFERRED_PROVIDER_virtual/bootloader = "u-boot-suniv"
PREFERRED_PROVIDER_u-boot-suniv = "u-boot-suniv"
UBOOT_MACHINE = "licheepi_nano_config"
SPL_BINARY ?= "u-boot-sunxi-with-spl.bin"
UBOOT_LOCALVERSION = "-g${@d.getVar('SRCPV', True).partition('+')[2][0:3]}"
UBOOT_ENTRYPOINT ?= "0x80008000"

#PREFERRED_PROVIDER_virtual/kernel ?= "linux-mainline"
#PREFERRED_VERSION_linux-suniv ?= "5.15"
#KERNEL_DEVICETREE = "suniv-f1c100s-licheepi-nano.dtb"
#KERNEL_IMAGETYPE ?= "uImage"

PREFERRED_PROVIDER_virtual/kernel ?= "linux-suniv"
PREFERRED_VERSION_linux-suniv ?= "5.2"
KERNEL_DEVICETREE = "suniv-f1c100s-licheepi-nano-with-lcd.dtb"
KERNEL_IMAGETYPE ?= "uImage"

MACHINE_ESSENTIAL_EXTRA_RRECOMMENDS = " kernel-modules"
MACHINE_ESSENTIAL_EXTRA_RDEPENDS = "kernel-image kernel-devicetree"

PREFERRED_VERSION_tslib = "1.22"
PREFERRED_VERSION_gdb = "11.2"

SERIAL_CONSOLES = "115200;ttyS0"
MACHINE_FEATURES ?= "alsa keyboard serial usbgadget usbhost vfat"

IMAGE_CLASSES += "sdcard_image-sunxi"
IMAGE_FSTYPES += "ext4 tar.gz tar.xz sunxi-sdimg"
```

## conf/machine/licheepinano-spinor.conf
```bitbake
#@TYPE: Machine
#@NAME: lichee-pi-nano
#@DESCRIPTION: Machine configuration for the lichee-pi-nano, base on Allwinner F1C100s CPU

require conf/machine/include/tune-arm926ejs.inc
include conf/machine/include/soc-family.inc

SOC_FAMILY = "suniv"

PREFERRED_PROVIDER_virtual/bootloader = "u-boot-suniv-spiflash"
PREFERRED_PROVIDER_u-boot-suniv-spiflash = "u-boot-suniv-spiflash"
UBOOT_MACHINE = "licheepi_nano_spiflash_config"
SPL_BINARY ?= "u-boot-sunxi-with-spl.bin"
UBOOT_LOCALVERSION = "-g${@d.getVar('SRCPV', True).partition('+')[2][0:3]}"
UBOOT_ENTRYPOINT ?= "0x80008000"

PREFERRED_PROVIDER_virtual/kernel ?= "linux-suniv"
PREFERRED_VERSION_linux-suniv ?= "5.2"
KERNEL_DEVICETREE = "suniv-f1c100s-licheepi-nano-with-lcd.dtb"
KERNEL_IMAGETYPE ?= "uImage"

MACHINE_ESSENTIAL_EXTRA_RRECOMMENDS = " kernel-modules"
MACHINE_ESSENTIAL_EXTRA_RDEPENDS = "kernel-image kernel-devicetree"

PREFERRED_VERSION_tslib = "1.21"
PREFERRED_VERSION_gdb = "9.1"

SERIAL_CONSOLES = "115200;ttyS0"
MACHINE_FEATURES ?= "alsa keyboard serial usbgadget usbhost vfat"

UBI_VOLNAME = "rootfs"

MKUBIFS_ARGS = "-F -m 64 -e 126976 -c 110"
UBINIZE_ARGS = "-m 64 -p 4KiB"

IMAGE_CLASSES += "spi-nor-jffs2"
IMAGE_FSTYPES += "tar.gz sunxi-spinor"
```

## conf/machine/licheepinano.conf
```bitbake
#@TYPE: Machine
#@NAME: lichee-pi-nano
#@DESCRIPTION: Machine configuration for the lichee-pi-nano, base on Allwinner F1C100s CPU

require conf/machine/include/suniv.inc

PREFERRED_PROVIDER_virtual/bootloader = "u-boot-suniv-spiflash"
PREFERRED_PROVIDER_u-boot-suniv-spiflash = "u-boot-suniv-spiflash"
UBOOT_MACHINE = "licheepi_nano_spiflash_config"
#PREFERRED_PROVIDER_virtual/bootloader = "u-boot-suniv"
#PREFERRED_PROVIDER_u-boot-suniv = "u-boot-suniv"
#UBOOT_MACHINE = "licheepi_nano_config"
SPL_BINARY ?= "u-boot-sunxi-with-spl.bin"
UBOOT_LOCALVERSION = "-g${@d.getVar('SRCPV', True).partition('+')[2][0:7]}"
UBOOT_ENTRYPOINT ?= "0x80008000"

PREFERRED_PROVIDER_virtual/kernel ?= "linux-suniv"
PREFERRED_VERSION_linux-suniv ?= "5.2"
KERNEL_DEVICETREE = "suniv-f1c100s-licheepi-nano-with-lcd.dtb"

MACHINE_ESSENTIAL_EXTRA_RRECOMMENDS = " kernel-modules"
MACHINE_ESSENTIAL_EXTRA_RDEPENDS = "kernel-image kernel-devicetree"

PREFERRED_VERSION_tslib = "1.21"
PREFERRED_VERSION_gdb = "9.1"

SERIAL_CONSOLES = "115200;ttyS0"
MACHINE_FEATURES ?= "alsa keyboard serial usbgadget usbhost vfat"

UBI_VOLNAME = "rootfs"

#For 128Mbytes NAND memory
MKUBIFS_ARGS = "-F -m 2048 -e 129024 -c 3848"
#For 1Gbytes NAND memory
#MKUBIFS_ARGS = "-F -m 4096 -e 520192 -c 4050"
#For 1Gbytes NAND memory from Samsung
#MKUBIFS_ARGS = "-F -m 2048 -e 129024 -c 7424"

#For 128Mbytes NAND memory
UBINIZE_ARGS = "-m 2048 -p 128KiB -s 512"
#For 1Gbytes NAND memory
#UBINIZE_ARGS = "-m 4096 -p 524288 -s 1024"
#For 1Gbytes NAND memory from Samsung
#UBINIZE_ARGS = "-m 2048 -p 128KiB -s 512"
```
